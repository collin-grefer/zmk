## app/boards/shields/corne_cirque/Kconfig.shield
```kconfig
config SHIELD_CORNE_CIRQUE_LEFT
    def_bool $(shields_list_contains,corne_cirque_left)

config SHIELD_CORNE_CIRQUE_RIGHT
    def_bool $(shields_list_contains,corne_cirque_right)
```

## app/boards/shields/trinidox/Kconfig.defconfig
```kconfig
if SHIELD_TRINIDOX_RIGHT

    config ZMK_KEYBOARD_NAME
        default "Trinidox"

    config ZMK_SPLIT_BLE_ROLE_CENTRAL
        default y

endif

if SHIELD_TRINIDOX_LEFT

    config ZMK_KEYBOARD_NAME
        default "Trinidox_left"
endif

if SHIELD_TRINIDOX_LEFT || SHIELD_TRINIDOX_RIGHT

    config ZMK_SPLIT
        default y

    config ZMK_USB
        default y

endif
```

## app/boards/shields/trinidox/Kconfig.shield
```kconfig
config SHIELD_TRINIDOX_LEFT
    def_bool $(shields_list_contains,trinidox_left)

config SHIELD_TRINIDOX_RIGHT
    def_bool $(shields_list_contains,trinidox_right)
```
